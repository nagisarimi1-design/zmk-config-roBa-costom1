/ {
    gesture_L5: gesture_L5 {
        compatible = "zmk,input-processor-mouse-gesture";
        #input-processor-cells = <0>;

        movement-threshold = <4>;   // 敏感に
        idle-timeout-ms = <80>;

        bindings = <
            &mkp LCLK   // 上で左クリック
            &mkp RCLK   // 下で右クリック
            &kp C_Z     // 右でUndo
            &kp C_Y     // 左でRedo
        >;
    };
};
