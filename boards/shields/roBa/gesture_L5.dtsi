/{
        gesture_window: gesture_window {
                compatible = "zmk,input-processor-mouse-gesture";
                #input-processor-cells = <0>;
        
                enable-eager-mode;
                movement-threshold = <6>;
                idle-timeout-ms = <120>;
                gesture-cooldown-ms = <150>;
        
                bindings = <
                    &kp LGUI KC_UP               // 上: 最大化
                    &kp LGUI KC_DOWN             // 下: 最小化
                    &kp LALT KC_TAB              // 右: 次のウィンドウ
                    &kp LALT LSHIFT KC_TAB       // 左: 前のウィンドウ
                >;
        };
};
